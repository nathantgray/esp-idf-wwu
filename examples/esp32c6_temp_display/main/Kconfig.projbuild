## examples/esp32c6_temp_display/main/Kconfig.projbuild
```kconfig
menu "Temperature Display Configuration"

    menu "Provisioning Service"
        choice EXAMPLE_PROV_TRANSPORT
            bool "Provisioning Transport"
            default EXAMPLE_PROV_TRANSPORT_BLE

            config EXAMPLE_PROV_TRANSPORT_BLE
                bool "BLE"
                select BT_ENABLED
                depends on !IDF_TARGET_ESP32S2

            config EXAMPLE_PROV_TRANSPORT_SOFTAP
                bool "Soft AP"
                select LWIP_IPV4
        endchoice

        choice EXAMPLE_PROV_SECURITY_VERSION
            bool "Protocomm security version"
            default EXAMPLE_PROV_SECURITY_VERSION_1

            config EXAMPLE_PROV_SECURITY_VERSION_1
                bool "Security version 1"
                select ESP_PROTOCOMM_SUPPORT_SECURITY_VERSION_1

            config EXAMPLE_PROV_SECURITY_VERSION_2
                bool "Security version 2"
                select ESP_PROTOCOMM_SUPPORT_SECURITY_VERSION_2
        endchoice

        config EXAMPLE_PROV_SEC2_DEV_MODE
            bool "Use Security Version 2 Dev Mode"
            depends on EXAMPLE_PROV_SECURITY_VERSION_2
            default y
            help
                Use Wi-Fi Provisioning Manager's Security Version 2 dev mode.

        config PROV_SERVICE_NAME
            string "Service Name"
            default "TempDisplay"
            help
                Name of the provisioning service for SoftAP SSID.

        config PROV_POP
            string "Proof of Possession"
            default "abcd1234"
            help
                Proof of Possession for provisioning security.
        
        config EXAMPLE_PROV_SHOW_QR
            bool "Show provisioning QR code"
            default y
            help
                Show the QR code for provisioning.

    endmenu

    menu "NeoPixel Display Configuration"
        config NEOPIXEL_GPIO
            int "NeoPixel Data GPIO"
            default 8
            range 0 48
            help
                GPIO pin number for NeoPixel data line on ESP32-C6.
                Recommended: GPIO 8

        config NEOPIXEL_BRIGHTNESS
            int "Initial Brightness (0-255)"
            default 200
            range 0 255
            help
                Initial brightness level for NeoPixel LEDs.

    endmenu

    menu "MQTT Configuration"
        config MQTT_BROKER_URI
            string "MQTT Broker URI"
            default "mqtt://homeassistant.local:1883"
            help
                Full URI of MQTT broker (e.g., mqtt://hostname:1883 or mqtts://hostname:8883)

        config MQTT_USERNAME
            string "MQTT Username"
            default "mqtt_user"
            help
                Username for MQTT broker authentication

        config MQTT_PASSWORD
            string "MQTT Password"
            default "mqtt_password"
            help
                Password for MQTT broker authentication

        config MQTT_TEMP_TOPIC
            string "Temperature Topic"
            default "home/livingroom/temperature"
            help
                MQTT topic to subscribe to for temperature readings.
                Home Assistant entity example: sensor.living_room_temperature
                Use the state topic from the sensor's MQTT Discovery configuration.

    endmenu

    menu "WiFi Configuration"
        config EXAMPLE_WIFI_SSID
            string "WiFi SSID"
            default ""
            help
                Optional: Pre-configured WiFi SSID. Leave empty to use provisioning.

        config EXAMPLE_WIFI_PASSWORD
            string "WiFi Password"
            default ""
            help
                Optional: Pre-configured WiFi password. Leave empty to use provisioning.

    endmenu

endmenu
```

## pawsaver_llm/main/Kconfig.projbuild
```kconfig
menu "Example Configuration"

    choice EXAMPLE_PROV_TRANSPORT
        bool "Provisioning Transport"
        default EXAMPLE_PROV_TRANSPORT_BLE
        help
            Wi-Fi provisioning component offers both, SoftAP and BLE transports. Choose any one.

        config EXAMPLE_PROV_TRANSPORT_BLE
            bool "BLE"
            select BT_ENABLED
            depends on !IDF_TARGET_ESP32S2
        config EXAMPLE_PROV_TRANSPORT_SOFTAP
            bool "Soft AP"
            select LWIP_IPV4
    endchoice

    choice EXAMPLE_PROV_SECURITY_VERSION
        bool "Protocomm security version"
        default EXAMPLE_PROV_SECURITY_VERSION_2
        help
            Wi-Fi provisioning component offers 3 security versions.
            The example offers a choice between security version 1 and 2.

        config EXAMPLE_PROV_SECURITY_VERSION_1
            bool "Security version 1"
            select ESP_PROTOCOMM_SUPPORT_SECURITY_VERSION_1

        config EXAMPLE_PROV_SECURITY_VERSION_2
            bool "Security version 2"
            select ESP_PROTOCOMM_SUPPORT_SECURITY_VERSION_2
    endchoice

    choice EXAMPLE_PROV_MODE
        bool "Security version 2 mode"
        depends on EXAMPLE_PROV_SECURITY_VERSION_2
        default EXAMPLE_PROV_SEC2_DEV_MODE

        config EXAMPLE_PROV_SEC2_DEV_MODE
            bool "Security version 2 development mode"
            depends on EXAMPLE_PROV_SECURITY_VERSION_2
            help
                This enables the development mode for security version 2.
                Please note that this mode is NOT recommended for production purpose.

        config EXAMPLE_PROV_SEC2_PROD_MODE
            bool "Security version 2 production mode"
            depends on EXAMPLE_PROV_SECURITY_VERSION_2
            help
                This enables the production mode for security version 2.
    endchoice

    config EXAMPLE_RESET_PROVISIONED
        bool
        default n
        prompt "Reset provisioned status of the device"
        help
            This erases the NVS to reset provisioned status of the device on every reboot.
            Provisioned status is determined by the Wi-Fi STA configuration, saved on the NVS.

    config EXAMPLE_RESET_PROV_MGR_ON_FAILURE
        bool
        default y
        prompt "Reset provisioned credentials and state machine after session failure"
        help
            Enable reseting provisioned credentials and state machine after session failure.
            This will restart the provisioning service after retries are exhausted.

    config EXAMPLE_PROV_MGR_MAX_RETRY_CNT
        int
        default 5
        prompt "Max retries before reseting provisioning state machine"
        depends on EXAMPLE_RESET_PROV_MGR_ON_FAILURE
        help
            Set the Maximum retry to avoid reconnecting to an inexistent AP or if credentials
            are misconfigured. Provisioned credentials are erased and internal state machine
            is reset after this threshold is reached.

    config EXAMPLE_PROV_SHOW_QR
        bool "Show provisioning QR code"
        default y
        help
            Show the QR code for provisioning.

    config EXAMPLE_PROV_USING_BLUEDROID
        bool
        depends on EXAMPLE_PROV_TRANSPORT_BLE && BT_BLUEDROID_ENABLED
        default y
        help
            This enables BLE provisioning using Bluedroid.

endmenu

menu "PawSaver Configuration"

    config PAWSAVER_MQTT_BROKER_URI
        string "MQTT Broker URI"
        default "mqtt://homeassistant.local:1883"
        help
            URI of the MQTT broker to connect to.

    config PAWSAVER_MQTT_USERNAME
        string "MQTT Username"
        default "mqtt_user"
        help
            Username for MQTT authentication.

    config PAWSAVER_MQTT_PASSWORD
        string "MQTT Password"
        default "EWB"
        help
            Password for MQTT authentication.

    config PAWSAVER_MQTT_TOPIC
        string "MQTT Publish Topic"
        default "pawsaver"
        help
            Topic to publish sensor data to.

    config PAWSAVER_I2C_SDA_PIN
        int "I2C SDA GPIO"
        default 22
        help
            GPIO pin for I2C SDA (MLX90614).

    config PAWSAVER_I2C_SCL_PIN
        int "I2C SCL GPIO"
        default 23
        help
            GPIO pin for I2C SCL (MLX90614).

    config PAWSAVER_BATTERY_ADC_CHANNEL
        int "Battery ADC Channel"
        default 0
        help
            ADC channel for battery voltage measurement.

    config PAWSAVER_VOLTAGE_DIVIDER_RATIO
        int "Voltage Divider Ratio x1000"
        default 1487
        help
            Voltage divider ratio multiplied by 1000 (e.g., 1.487 = 1487).
            Adjust based on your resistor values.

endmenu
```

## pawsaver_llm/sdkconfig.defaults
```kconfig
# PawSaver Default Configuration

# Flash size for XIAO ESP32-C6
CONFIG_ESPTOOLPY_FLASHSIZE_4MB=y

# BLE Provisioning
CONFIG_EXAMPLE_PROV_TRANSPORT_BLE=y
CONFIG_BT_ENABLED=y
CONFIG_BT_NIMBLE_ENABLED=y

# Security Version 1 (simpler for testing)
CONFIG_EXAMPLE_PROV_SECURITY_VERSION_1=y
CONFIG_ESP_PROTOCOMM_SUPPORT_SECURITY_VERSION_1=y


# Wi-Fi
CONFIG_ESP_WIFI_SSID=""
CONFIG_ESP_WIFI_PASSWORD=""

# Power Management
CONFIG_PM_ENABLE=y
CONFIG_PM_DFS_INIT_AUTO=y

# Log level (reduce for production)
CONFIG_LOG_DEFAULT_LEVEL_INFO=y

# Partition table - use custom
CONFIG_PARTITION_TABLE_CUSTOM=y
CONFIG_PARTITION_TABLE_CUSTOM_FILENAME="partitions.csv"

# ===== SIZE OPTIMIZATION =====

# Compiler optimization for size
CONFIG_COMPILER_OPTIMIZATION_SIZE=y

# Disable features we don't need
CONFIG_BOOTLOADER_LOG_LEVEL_WARN=y
CONFIG_LOG_MAXIMUM_LEVEL_INFO=y

# NimBLE optimization - disable unused features
CONFIG_BT_NIMBLE_MAX_CONNECTIONS=1
CONFIG_BT_NIMBLE_MAX_BONDS=1
CONFIG_BT_NIMBLE_MAX_CCCDS=4
CONFIG_BT_NIMBLE_ROLE_CENTRAL=n
CONFIG_BT_NIMBLE_ROLE_OBSERVER=n
CONFIG_BT_NIMBLE_ROLE_BROADCASTER=n
CONFIG_BT_NIMBLE_ROLE_PERIPHERAL=y
CONFIG_BT_NIMBLE_50_FEATURE_SUPPORT=n
CONFIG_BT_NIMBLE_EXT_ADV=n
CONFIG_BT_NIMBLE_CRYPTO_STACK_MBEDTLS=n
CONFIG_BT_NIMBLE_MESH=n

# Disable Wi-Fi features we don't need
CONFIG_ESP_WIFI_SOFTAP_SUPPORT=n
CONFIG_ESP_WIFI_ENTERPRISE_SUPPORT=n
CONFIG_ESP_WIFI_NAN_ENABLE=n

# LWIP optimization
CONFIG_LWIP_IPV6=n
CONFIG_LWIP_MAX_SOCKETS=4
CONFIG_LWIP_TCP_SND_BUF_DEFAULT=2880
CONFIG_LWIP_TCP_WND_DEFAULT=5744

# MQTT - minimal config
CONFIG_MQTT_TRANSPORT_SSL=n
CONFIG_MQTT_TRANSPORT_WEBSOCKET=n

# mbedTLS - disable unused features
CONFIG_MBEDTLS_SSL_MAX_CONTENT_LEN=4096
CONFIG_MBEDTLS_ASYMMETRIC_CONTENT_LEN=y
CONFIG_MBEDTLS_SSL_IN_CONTENT_LEN=4096
CONFIG_MBEDTLS_SSL_OUT_CONTENT_LEN=2048
CONFIG_MBEDTLS_CERTIFICATE_BUNDLE=n
CONFIG_MBEDTLS_ECP_DP_SECP192R1_ENABLED=n
CONFIG_MBEDTLS_ECP_DP_SECP224R1_ENABLED=n
CONFIG_MBEDTLS_ECP_DP_SECP384R1_ENABLED=n
CONFIG_MBEDTLS_ECP_DP_SECP521R1_ENABLED=n
CONFIG_MBEDTLS_ECP_DP_SECP192K1_ENABLED=n
CONFIG_MBEDTLS_ECP_DP_SECP224K1_ENABLED=n
CONFIG_MBEDTLS_ECP_DP_BP256R1_ENABLED=n
CONFIG_MBEDTLS_ECP_DP_BP384R1_ENABLED=n
CONFIG_MBEDTLS_ECP_DP_BP512R1_ENABLED=n
CONFIG_MBEDTLS_ECP_DP_CURVE25519_ENABLED=n

# Disable unused components
CONFIG_ESP_HTTPS_OTA_ALLOW_HTTP=n
CONFIG_HTTPD_MAX_REQ_HDR_LEN=512
CONFIG_HTTPD_MAX_URI_LEN=512

# Newlib - use nano version
CONFIG_NEWLIB_NANO_FORMAT=y
```
